## com/as.application/Kconfig
```kconfig
source "$ASROOT/com/as.application/board.$BOARD/Kconfig"

config RTE
	bool "Run Time Environment"
	default y if ARCH_POSIX

config RTE_SWC_TELLTALE
	bool "demo telltale software component"
	default y if ARCH_POSIX && DIO
```

## com/as.application/board.at91sam3s/Kconfig
```kconfig
config ARCH_AT91SAM3S
    bool
    default y
    select DEFAULT_TOPPERS_OSEK

config DEMO_LED_APP
	bool "demo led application"
	default y

config DEMO_USB_APP
	bool "demo USB application"
	default y
	depends on USB_DRV
```

## com/as.application/board.posix/Kconfig
```kconfig
config ARCH_POSIX
    bool
    default y
    select DEFAULT_SMALLOS

config ARCH
    string
    default "posix"
```

## com/as.application/board.stm32f107vc/Kconfig
```kconfig
config ARCH_STM31F1
    bool
    default y
    select DEFAULT_ASKAR

config DEMO_LED_APP
	bool "demo led application"
	default y
	depends on DIO

config ARCH
    string
    default "stm32f1"
```

## com/as.application/board.versatilepb/Kconfig
```kconfig
config ARCH_VERSATILEPB
    bool
    default y
    select DEFAULT_TOPPERS_OSEK

config ARCH
    string
    default "versatilepb"
```

## com/as.infrastructure/arch/Kconfig
```kconfig
source "$ASROOT/com/as.infrastructure/arch/posix/Kconfig"
source "$ASROOT/com/as.infrastructure/arch/versatilepb/Kconfig"
source "$ASROOT/com/as.infrastructure/arch/x86/Kconfig"
source "$ASROOT/com/as.infrastructure/arch/s3c2440a/Kconfig"
```

## com/as.infrastructure/arch/at91sam3s/Kconfig
```kconfig
if ARCH_AT91SAM3S
menu "AUTOSAR MCAL&CDD for arch AT91SAM3S"

config MCU
	bool "MCAL MCU driver"
	default y

config USB_DRV
	bool "USB driver"
	default y

endmenu
endif
```

## com/as.infrastructure/arch/none/Kconfig
```kconfig
if ARCH_ANY
menu "AUTOSAR MCAL&CDD for arch ANY"

config CAN
	bool "MCAL CAN driver"
	default n

config DIO
	bool "MCAL DIO driver"
	default n

config MCU
	bool "MCAL MCU driver"
	default y

config PORT
	bool "MCAL PORT driver"
	default n

endmenu
endif
```

## com/as.infrastructure/arch/posix/Kconfig
```kconfig
if ARCH_POSIX
menu "AUTOSAR MCAL&CDD for arch posix"

config CAN
	bool "MCAL CAN driver"
	default y

config DIO
	bool "MCAL DIO driver"
	default y

config FATFS_DRV
	bool "FATFS diskio driver"
	default y

config LWEXT4_DRV
	bool "LWEXT4 blockdev driver"
	default y

config EEP
	bool "MCAL EEP driver"
	default y

config FLASH
	bool "HIS FLASH driver for bootloader"
	default n

config FLS
	bool "MCAL FLS driver"
	default y

config IPC
	bool "Inter Processor Communication driver"
	default n
	help
	  This driver is used to simulate the Inter Processor Communication device
	  for the purpose to study RPMSG&VIRTIO

config LCD
	bool "LCD driver"
	default n

choice
	prompt "LCD simulated by"
	default GTK

config GTK
	bool "gtk"
	depends on LCD

config OPENVG
	bool "openvg(windows only)"
	depends on LCD

endchoice

config MCU
	bool "MCAL MCU driver"
	default y

config PORT
	bool "MCAL PORT driver"
	default y

config STMO
	bool "Step Motor driver"
	default y
	help
	  This driver is used to simulate the step motor which if usually used by
	  instrument cluster as gauge pointer.

config LWIP_DRV
	bool "LWIP driver"
	default y

endmenu
endif
```

## com/as.infrastructure/arch/stm32f1/Kconfig
```kconfig
if ARCH_STM31F1
menu "AUTOSAR MCAL&CDD for arch STM32F1"

config CAN
	bool "MCAL CAN driver"
	default y

config DIO
	bool "MCAL DIO driver"
	default y

config MCU
	bool "MCAL MCU driver"
	default y

config PORT
	bool "MCAL PORT driver"
	default y

config LWIP_DRV
	bool "LWIP driver"
	default y

endmenu
endif
```

## com/as.infrastructure/arch/versatilepb/Kconfig
```kconfig
if ARCH_VERSATILEPB
menu "AUTOSAR MCAL&CDD for arch versatilepb"

config CAN
	bool "MCAL CAN driver"
	default y

config FATFS
	bool "FATFS diskio driver"
	default y

config LWEXT4
	bool "LWEXT4 blockdev driver"
	default y

config EEP
	bool "MCAL EEP driver"
	depends on (FATFS || LWEXT4)
	default y

config FLS
	bool "MCAL FLS driver"
	depends on (FATFS || LWEXT4)
	default y

config LCD
	bool "LCD driver"
	default y

config MCU
	bool "MCAL MCU driver"
	default y

config LWIP
	bool "LWIP driver"
	default y

endmenu
endif
```

## com/as.infrastructure/clib/Kconfig
```kconfig
menu "C Library"

config CLIB_ASHEAP
	bool "Memory Heap malloc/free..."
	default n

config CLIB_MBOX
	bool "Message Box"
	default y

config CLIB_MISCLIB
	bool "Miscellaneous C Library"
	default y

config CLIB_QSORT
	bool "Queue Sort"
	default y

config CLIB_STDIO_PRINTF
	bool "stdio printf related"
	default y

config CLIB_STDIO_CAN
	bool "stdio on CAN"
	default y

config CLIB_STRTOK_R
	bool "string related"
	default y

config CLIB_NWELIB
	bool "Newlib: a C library intended for use on embedded systems"
	default n

endmenu
```

## com/as.infrastructure/libraries/Kconfig
```kconfig
menu "libraries"

config IFX
	bool "Interpolation Fixed point"
	default y

config FDT
	bool "flat device tree library"
	default y

config TRACE
	bool "enable the trace library"
	default y

config RINGBUFFER
	bool "simple ringbuffer library"
	default y

endmenu
```

## com/as.infrastructure/system/Kconfig
```kconfig
menu "System"

config CRC
	bool "CRC"
	default y

config ECUM
	bool "Ecu Manager"
	default y

config SG
	bool "Static GUI"
	default y
	depends on LCD

config SCHM
	bool "Scheduler Manager"
	default y

config SHELL
	bool "SHELL"
	default y
	depends on !RTTHREAD

config CPLUSPLUS
	bool "C++ support"
	default n

source "$ASROOT/com/as.infrastructure/system/fs/Kconfig"
source "$ASROOT/com/as.infrastructure/system/kernel/Kconfig"
source "$ASROOT/com/as.infrastructure/system/net/Kconfig"

endmenu
```

## com/as.infrastructure/system/kernel/Kconfig
```kconfig
menu "Operating System"

config DEFAULT_ASKAR
	bool

config DEFAULT_SMALLOS
	bool

config DEFAULT_RTTHREAD
	bool

config DEFAULT_ATK2_SC4
	bool

config DEFAULT_TRAMPOLINE
	bool

config DEFAULT_TOPPERS_OSEK
	bool

config DEFAULT_FREERTOS
	bool

choice
	prompt "RTOS"
	default ASKAR if DEFAULT_ASKAR
	default SMALLOS if DEFAULT_SMALLOS
	default RTTHREAD if DEFAULT_RTTHREAD
	default ATK2_SC4 if DEFAULT_ATK2_SC4
	default TRAMPOLINE if DEFAULT_TRAMPOLINE
	default TOPPERS_OSEK if DEFAULT_TOPPERS_OSEK
	default FREERTOS if DEFAULT_FREERTOS

config ASKAR
	bool "askar:Automotive oSeK AutosaR/pthreads RTOS"

config SMALLOS
	bool "small OSEK BCC1 RTOS"

config RTTHREAD
	bool "rt-thread"

config ATK2_SC4
	bool "ask-sc4"

config TRAMPOLINE
	bool "trampoline"

config TOPPERS_OSEK
	bool "toppers osek"

config FREERTOS
	bool "freertos"

config ANYOS
	bool "any other 3rd party OS under board.any"

endchoice

config PROTOTHREAD
	bool "protothread(or named coroutine)"
	default y if !ARCH_POSIX

if ASKAR
source "$ASROOT/com/as.infrastructure/system/kernel/askar/Kconfig"
endif

endmenu
```

## com/as.infrastructure/system/kernel/askar/Kconfig
```kconfig
choice
	prompt "Schedule Policy"
	default SCHED_BUBBLE

config SCHED_BUBBLE
	bool "bubble sort scheduler"

config SCHED_FIFO
	bool "fifo scheduler"

config SCHED_LIST
	bool "list scheduler"

endchoice

config PTHREAD
	bool "posix pthreads based on askar OSEK core"
	default y

config PTHREAD_SIGNAL
	bool "posix pthreads signal"
	default y
```

## com/as.infrastructure/system/kernel/rtthread/menuconfig/Kconfig
```kconfig
config RTT_DIR
    string
    option env="RTT_ROOT"
    default "../../com/as.infrastructure/system/kernel/rtthread/rt-thread"

source "$ASROOT/com/as.infrastructure/system/kernel/rtthread/rt-thread/Kconfig"
source "$ASROOT/com/as.infrastructure/system/kernel/rtthread/menuconfig/aspkgs/Kconfig"
```

## com/as.infrastructure/system/net/Kconfig
```kconfig
menu "Internet Protocol"
config LWIP
	bool "LWIP"
	depends on LWIP_DRV
	default y

if !RTTHREAD
choice
	prompt "LWIP arch"
	default LWIP_POSIX_ARCH if PTHREAD || ARCH_POSIX
	default LWIP_OSEK_ARCH  if !PTHREAD && !ARCH_POSIX

config LWIP_POSIX_ARCH
	bool "lwip standard porting based on pthread"

config LWIP_OSEK_ARCH
	bool "lwip standard porting based on OSEK"

endchoice
endif

config FTP
	bool "File Transfer Protocol Daemon"
	depends on LWIP && (VFS || RT_USING_DFS)
	default y

endmenu
```

## release/ascore/SgDesign/Kconfig
```kconfig
choice
	prompt "SG demo application"
	default SG_DEMO_WATCH
	depends on SG

config SG_DEMO_CLUSTER
	bool "automative virtual instrument cluster"

config SG_DEMO_WATCH
	bool "a sample watch"

endchoice
```
